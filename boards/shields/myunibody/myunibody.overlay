#include "myunibody.dtsi"

/ {
    kscan0: kscan0 {
        compatible = "zmk,kscan-gpio-direct";
        wakeup-source;

        input-gpios
            = <&pico_header 6 (GPIO_ACTIVE_LOW | GPIO_PULL_UP)>
            , <&pico_header 7 (GPIO_ACTIVE_LOW | GPIO_PULL_UP)>
            ;
    };
};

&physical_layout_myunibody {
    kscan = <&kscan0>;
};

